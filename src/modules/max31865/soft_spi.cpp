/***********************************************************************
 * @file 	:	soft_spi.cpp
 * @author	:	ch
 * @brief	:
 * @version:	v1.0
 * @Copyright (C)  2021-02-13  .cdWFVCEL. all right reserved
***********************************************************************/

/* 包含头文件 -------------------------------------------------------------------*/
#include "soft_spi.h"
/* 宏定义 -----------------------------------------------------------------------*/
/* 类型定义 ---------------------------------------------------------------------*/
/* 私有变量 ---------------------------------------------------------------------*/
/* 扩展变量 ---------------------------------------------------------------------*/
/* 私有函数声明 -----------------------------------------------------------------*/
/* 函数声明 ---------------------------------------------------------------------*/
/* 函数实现 ---------------------------------------------------------------------*/

void SoftSPI::begin(uint32_t cs_pin, uint32_t clk_pin, uint32_t miso_pin, uint32_t mosi_pin)
{
    _cs_pin = cs_pin;
    _clk_pin = clk_pin;
    _miso_pin = miso_pin;
    _mosi_pin = mosi_pin;
    pinMode(cs_pin, OUTPUT);
    pinMode(clk_pin, OUTPUT);
    pinMode(miso_pin, INPUT);
    pinMode(mosi_pin, OUTPUT);
    CS_High();
}

/**************************************************
 函数：SOFT_SPI_RW()
 描述: 根据SPI协议，写一字节数据到从机，同时从从机
 读出一字节
 **************************************************/
uint8_t SoftSPI::SPI_ReadWrite(uint8_t byte)
{
    uint8_t i, Temp = 0;
    for (i = 0; i < 8; i++)
    {
        //		SPI_SCLK_H;
        if (byte & 0x80)
            MOSI_High();
        else
            MOSI_Low();
        byte <<= 1;
        CLK_High();
        delay_us(2);
        Temp <<= 1;
        if (MISO_Read())
            Temp++;
        CLK_Low();
        delay_us(2);
    }
    return Temp;
}
